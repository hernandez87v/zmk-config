## config/boards/shields/leeloov2/Kconfig.shield
```kconfig
# Copyright (c) 2022 The ZMK Contributors
# SPDX-License-Identifier: MIT

config SHIELD_LEELOOV2_LEFT
	def_bool $(shields_list_contains,leeloov2_left)

config SHIELD_LEELOOV2_RIGHT
	def_bool $(shields_list_contains,leeloov2_right)
```
